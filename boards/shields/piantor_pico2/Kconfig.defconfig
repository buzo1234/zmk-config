## boards/shields/piantor_pico2/Kconfig.defconfig
```kconfig
if SHIELD_PIANTOR_PICO2_LEFT

config ZMK_KEYBOARD_NAME
    default "Piantor Pico2"

config ZMK_SPLIT_ROLE_CENTRAL
    default y

config ZMK_USB
    default y

endif

if SHIELD_PIANTOR_PICO2_RIGHT

config ZMK_USB
    default n

endif

if SHIELD_PIANTOR_PICO2_LEFT || SHIELD_PIANTOR_PICO2_RIGHT

config ZMK_SPLIT
    default y

endif
```

## boards/shields/piantor_pico2/Kconfig.shield
```kconfig
config SHIELD_PIANTOR_PICO2_LEFT
    def_bool $(shields_list_contains,piantor_pico2_left)
    select ZMK_BOARD_COMPAT

config SHIELD_PIANTOR_PICO2_RIGHT
    def_bool $(shields_list_contains,piantor_pico2_right)
    select ZMK_BOARD_COMPAT
```
